## Firmware/ESP32/SPICentralTest/main/Kconfig.projbuild
```kconfig
# put here your custom config value
menu "Project Configuration"
config ESP_WIFI_SSID
    string "WiFi SSID"
    default "myssid"
    help
	SSID (network name) for the example to connect to.

config ESP_WIFI_PASSWORD
    string "WiFi Password"
    default "mypassword"
    help
	WiFi password (WPA or WPA2) for the example to use.

config CONFIG_FREERTOS_GENERATE_RUN_TIME_STATS
    bool "Enable FreeRTOS Task Runtime Stats"
    default n

endmenu
```
